## drivers/staging/sun8i-ss/Kconfig
```kconfig
config CRYPTO_DEV_SUN8I_SS
	tristate "Support for Allwinner Crypto Engine cryptographic accelerator"
	select CRYPTO_BLKCIPHER
	select CRYPTO_ENGINE
	help
	  Select y here for having support for the crypto Engine availlable on
	  Allwinner SoC H3 and A64.
	  The Crypto Engine handle AES/DES/3DES ciphers in CBC mode
	  and MD5, SHA1, SHA224, SHA256, SHA384 and SHA512 hash algorithms.

	  To compile this driver as a module, choose M here: the module
	  will be called sun8i-ss.

config CRYPTO_DEV_SUN8I_SS_PRNG
	bool "Support for sun8i Allwinner Security System PRNG"
	depends on CRYPTO_DEV_SUN8I_SS
	select HW_RANDOM
	help
	  This driver provides kernel-side support for the Pseudo-Random
	  Number Generator found in the sun8i Security System.

config CRYPTO_DEV_SUN8I_SS_RSA
	bool "Support for sun8i Allwinner Security System RSA"
	depends on CRYPTO_DEV_SUN8I_SS
	select CRYPTO_RSA
	help
	  This driver provides kernel-side support for the RSA TODO
	  found in the sun8i Security System.
```
